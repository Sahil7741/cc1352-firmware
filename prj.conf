## CMakeLists.txt
```
# SPDX-License-Identifier: Apache-2.0

cmake_minimum_required(VERSION 3.20.0)

find_package(Zephyr REQUIRED HINTS $ENV{ZEPHYR_BASE})
project(cc1352_firmware)

target_include_directories(app PRIVATE include)

add_subdirectory(src)
```

## Kconfig
```
mainmenu "CC1352 GREYBUS Host Application"

config BEAGLEPLAY_GREYBUS_MAX_NODES
  int "Maximum number of cports supported by AP"
  default 1

config BEAGLEPLAY_GREYBUS_MAX_INTERFACES
  int "Maximum number of interfaces supported by SVC"
  default 1

config BEAGLEPLAY_HDLC_MAX_BLOCK_SIZE
  int "Maximum hdlc block size supported"
  default 140

config BEAGLEPLAY_GREYBUS_MESSAGES_HEAP_MEM_POOL_SIZE
	int "Heap for Greybus messages"
	default 2048

config BEAGLEPLAY_GREYBUS_MAX_CPORTS
	int "Maximum number of Cports supported by SVC"
	default 32

config BEAGLEPLAY_GREYBUS_MDNS_DISCOVERY
	bool "Enable mdns based node discovery"
	default y

config BEAGLEPLAY_GREYBUS_NODE1
	string "Address of Node1"

module = BEAGLEPLAY_GREYBUS
module-str = beagleplay_greybus
source "subsys/logging/Kconfig.template.log_config"

source "Kconfig.zephyr"
```

## sample.yaml
```
sample:
  description: Hello World sample, the simplest Zephyr
    application
  name: cc1352 firmware
common:
  tags: introduction
  integration_platforms:
    - native_posix
  harness: console
  harness_config:
    type: one_line
    regex:
      - "Hello World! (.*)"
tests:
  sample.basic.helloworld:
    tags: introduction
```

## west.yml
```
# Copyright (c) 2024 Ayush Singh <ayush@beagleboard.org>
# SPDX-License-Identifier: Apache-2.0

manifest:
  self:
    west-commands: scripts/west-commands.yml

  remotes:
    - name: zephyrproject-rtos
      url-base: https://github.com/zephyrproject-rtos

  projects:
    - name: zephyr
      remote: zephyrproject-rtos
      revision: main
      import:
        name-allowlist:
          - hal_ti
          - cmsis_6
          
```

## prj.conf
```kconfig
# UART
CONFIG_SERIAL=y
CONFIG_UART_INTERRUPT_DRIVEN=y

# Logging
CONFIG_LOG=y
CONFIG_LOG_OUTPUT=y
CONFIG_BEAGLEPLAY_GREYBUS_LOG_LEVEL_DBG=y

# Networking
CONFIG_NETWORKING=y
CONFIG_NET_UDP=y
CONFIG_NET_TCP=y
CONFIG_NET_IPV4=y
CONFIG_NET_IPV6=y

# Generic networking options
CONFIG_NET_SOCKETS=y
CONFIG_NET_SOCKETS_POLL_MAX=32
CONFIG_NET_CONNECTION_MANAGER=y
CONFIG_HEAP_MEM_POOL_SIZE=512
CONFIG_NET_SOCKETPAIR=y
CONFIG_NET_TCP_RETRY_COUNT=4
CONFIG_NET_TCP_INIT_RETRANSMISSION_TIMEOUT=200
# TODO: Use keepalive once switch to upstream zephyr
# CONFIG_NET_TCP_KEEPALIVE=y
# CONFIG_NET_TCP_KEEPIDLE_DEFAULT=1
# CONFIG_NET_TCP_KEEPINTVL_DEFAULT=1
# CONFIG_NET_TCP_KEEPCNT_DEFAULT=2

# TODO: Switch to eventfd once using upstream zephyr
# CONFIG_EVENTFD=y

# Network Config
CONFIG_NET_CONFIG_SETTINGS=y
CONFIG_NET_CONFIG_AUTO_INIT=y
CONFIG_NET_CONFIG_NEED_IPV6=y
CONFIG_NET_CONFIG_NEED_IPV4=y
CONFIG_NET_CONFIG_MY_IPV6_ADDR="2001:db8::2"
CONFIG_NET_CONFIG_PEER_IPV6_ADDR="2001:db8::1"
CONFIG_NET_CONFIG_MY_IPV4_ADDR="192.0.2.2"
CONFIG_NET_CONFIG_PEER_IPV4_ADDR="192.0.2.1"

# Config options that probably should go into Kconfig.defconf
CONFIG_NET_L2_IEEE802154=y
CONFIG_NET_CONFIG_IEEE802154_CHANNEL=1
CONFIG_IEEE802154_CC13XX_CC26XX_SUB_GHZ_NUM_RX_BUF=8
CONFIG_NET_CONFIG_IEEE802154_RADIO_TX_POWER=20
CONFIG_IEEE802154_CC13XX_CC26XX_SUB_GHZ_CS_THRESHOLD=-20
CONFIG_NET_CONFIG_IEEE802154_PAN_ID=0xabcd
CONFIG_IEEE802154_CC13XX_CC26XX=n
CONFIG_NET_DEFAULT_IF_IEEE802154=y

# Kernel options
CONFIG_ENTROPY_GENERATOR=y
CONFIG_TEST_RANDOM_GENERATOR=y

# Network buffers
CONFIG_NET_PKT_RX_COUNT=32
CONFIG_NET_PKT_TX_COUNT=32
CONFIG_NET_BUF_RX_COUNT=32
CONFIG_NET_BUF_TX_COUNT=32
CONFIG_NET_L2_IEEE802154_FRAGMENT_REASS_CACHE_SIZE=8

# IP address options
CONFIG_NET_IF_UNICAST_IPV6_ADDR_COUNT=3
CONFIG_NET_IF_MCAST_IPV6_ADDR_COUNT=4
CONFIG_NET_MAX_CONTEXTS=10

# MISC
CONFIG_RING_BUFFER=y

# Application Config
CONFIG_BEAGLEPLAY_GREYBUS_MAX_NODES=32
CONFIG_BEAGLEPLAY_HDLC_MAX_BLOCK_SIZE=256
CONFIG_BEAGLEPLAY_GREYBUS_MAX_INTERFACES=10
CONFIG_BEAGLEPLAY_GREYBUS_MESSAGES_HEAP_MEM_POOL_SIZE=4096
CONFIG_THREAD_NAME=y
CONFIG_THREAD_MONITOR=y
CONFIG_CRC=y
CONFIG_BEAGLEPLAY_GREYBUS_MDNS_DISCOVERY=n
CONFIG_BEAGLEPLAY_GREYBUS_NODE1="2001:db8::1"
CONFIG_NET_L2_IEEE802154_RADIO_ALOHA=y
```

## src/main.c
```c
// SPDX-License-Identifier: Apache-2.0
/*
 * Copyright (c) 2023 Ayush Singh <ayushdevel1325@gmail.com>
 */

#include "ap.h"
#include "apbridge.h"
#include "greybus_protocols.h"
#include "hdlc.h"
#include "node.h"
#include "svc.h"
#include "tcp_discovery.h"
#include <zephyr/drivers/uart.h>
#include <zephyr/init.h>
#include <zephyr/kernel.h>
#include <zephyr/logging/log.h>
#include <zephyr/net/net_ip.h>

#define UART_DEVICE_NODE  DT_CHOSEN(zephyr_shell_uart)
#define CONTROL_SVC_START 0x01
#define CONTROL_SVC_STOP  0x02

LOG_MODULE_REGISTER(cc1352_greybus, CONFIG_BEAGLEPLAY_GREYBUS_LOG_LEVEL);

static const struct device *const uart_dev = DEVICE_DT_GET(UART_DEVICE_NODE);

/**
 * struct hdlc_greybus_frame - Structure to represent greybus HDLC frame
 *
 * @cport: cport id
 * @hdr: greybus operation header
 * @payload: greybus message payload
 */
struct hdlc_greybus_frame {
	uint16_t cport;
	struct gb_operation_msg_hdr hdr;
	uint8_t payload[];
} __packed;

static int hdlc_send_callback(const uint8_t *buffer, size_t buffer_len)
{
	size_t i;

	for (i = 0; i < buffer_len; ++i) {
		uart_poll_out(uart_dev, buffer[i]);
	}

	return i;
}

static void serial_callback(const struct device *dev, void *user_data)
{
	ARG_UNUSED(user_data);

	uint8_t *buf;
	int ret;

	if (!uart_irq_update(dev) && !uart_irq_rx_ready(dev)) {
		return;
	}

	ret = hdlc_rx_start(&buf);
	if (ret == 0) {
		/* No space */
		LOG_ERR("No more space for HDLC receive");
		return;
	}

	ret = uart_fifo_read(dev, buf, ret);
	if (ret < 0) {
		/* Something went wrong */
		LOG_ERR("Failed to read UART");
		return;
	}

	ret = hdlc_rx_finish(ret);
	if (ret < 0) {
		/* Some error */
		LOG_ERR("Filed to write data to hdlc buffer");
		return;
	}
}

static int hdlc_process_greybus_frame(const char *buffer, size_t buffer_len)
{
	struct gb_message *msg;
	int ret;
	struct hdlc_greybus_frame *gb_frame = (struct hdlc_greybus_frame *)buffer;
	size_t msg_len = buffer_len - sizeof(uint16_t);
	struct gb_operation_msg_hdr *hdr = (struct gb_operation_msg_hdr *)&buffer[sizeof(uint16_t)];

	if (sys_le16_to_cpu(gb_frame->hdr.size) > msg_len) {
		LOG_ERR("Greybus Message size is greater than received buffer.");
		return -1;
	}

	msg = gb_message_alloc(gb_hdr_payload_len(hdr), gb_frame->hdr.type,
			       gb_frame->hdr.operation_id, gb_frame->hdr.result);
	if (!msg) {
		LOG_ERR("Failed to allocate greybus message");
		return -1;
	}

	memcpy(msg->payload, gb_frame->payload, gb_message_payload_len(msg));
	ret = ap_rx_submit(msg, sys_le16_to_cpu(gb_frame->cport));
	if (ret < 0) {
		LOG_ERR("Failed add message to AP Queue");
		return ret;
	}

	return 0;
}

static int control_process_frame(const char *buffer, size_t buffer_len)
{
	uint8_t command;
	int ret;

	if (buffer_len != 1) {
		LOG_ERR("Invalid Buffer");
		return -1;
	}

	command = buffer[0];

	switch (command) {
	case CONTROL_SVC_START: {
		LOG_INF("Starting SVC");
		ap_init();
		svc_init();
		apbridge_init();
		ret = connection_create(AP_INF_ID, 0, SVC_INF_ID, 0);
		if (ret < 0) {
			LOG_ERR("Failed to create connection between AP and SVC");
			return ret;
		}
		svc_send_version();
		tcp_discovery_start();
		return 0;
	}
	case CONTROL_SVC_STOP:
		LOG_INF("Stopping SVC");
		tcp_discovery_stop();
		node_destroy_all();
		svc_deinit();
		ap_deinit();
		apbridge_deinit();
		return 0;
	}

	return -1;
}

static int hdlc_process_complete_frame(const void *buffer, size_t len, uint8_t address)
{
	switch (address) {
	case ADDRESS_GREYBUS:
		return hdlc_process_greybus_frame(buffer, len);
	case ADDRESS_CONTROL:
		return control_process_frame(buffer, len);
	case ADDRESS_DBG:
		LOG_WRN("Ignore DBG Frame");
		return 0;
	}

	return -1;
}

int main(void)
{
	int ret;

	LOG_INF("Starting BeaglePlay Greybus");
	tcp_discovery_stop();

	if (!device_is_ready(uart_dev)) {
		LOG_ERR("UART device not found!");
		return -ENODEV;
	}

	hdlc_init(hdlc_process_complete_frame, hdlc_send_callback);

	ret = uart_irq_callback_user_data_set(uart_dev, serial_callback, NULL);
	if (ret < 0) {
		if (ret == -ENOTSUP) {
			LOG_ERR("Interrupt-driven UART API support not enabled\n");
		} else if (ret == -ENOSYS) {
			LOG_ERR("UART device does not support interrupt-driven API\n");
		} else {
			LOG_ERR("Error setting UART callback: %d\n", ret);
		}
		return ret;
	}

	uart_irq_rx_enable(uart_dev);

	k_sleep(K_FOREVER);

	return 0;
}
```

## include/ap.h
```c
/* SPDX-License-Identifier: Apache-2.0 */
/*
 * Copyright (c) 2023 Ayush Singh <ayushdevel1325@gmail.com>
 */

#ifndef _AP_H_
#define _AP_H_

#include "apbridge.h"
#include "greybus_messages.h"
#include "greybus_interfaces.h"

#define AP_MAX_NODES CONFIG_BEAGLEPLAY_GREYBUS_MAX_NODES

#define AP_INF_ID       1
#define AP_SVC_CPORT_ID 0

/*
 * Initialize AP interface
 *
 * @return AP Interface
 */
void ap_init(void);

/*
 * De-Initialize AP Interface
 *
 * Note: This should be called only after all connections have been closed. This does not take care
 * of closing connections or flushing pending data.
 */
void ap_deinit(void);

/*
 * Submit message received by AP from transport
 *
 * @param greybus message
 * @param cport_id
 *
 * @return 0 if successful, negative in case of error
 */
static inline int ap_rx_submit(struct gb_message *msg, uint16_t cport_id)
{
	return connection_send(AP_INF_ID, cport_id, msg);
}

int ap_send(struct gb_message *msg, uint16_t cport);

#endif
```

## include/apbridge.h
```c
/* SPDX-License-Identifier: Apache-2.0 */
/*
 * Copyright (c) 2023 Ayush Singh <ayushdevel1325@gmail.com>
 */

#ifndef _APBRIDGE_H_
#define _APBRIDGE_H_

#include <stdint.h>
#include "greybus_messages.h"

void apbridge_init(void);

void apbridge_deinit(void);

int connection_create(uint8_t intf1_id, uint16_t intf1_cport, uint8_t intf2_id,
		      uint16_t intf2_cport);

int connection_destroy(uint8_t intf1_id, uint16_t intf1_cport, uint8_t intf2_id,
		       uint16_t intf2_cport);

int connection_send(uint8_t intf_id, uint16_t intf_cport, struct gb_message *msg);

/*
 * Send a message to the node
 *
 * @msg: The message to send
 * @cport: The cport of ap
 *
 * Returns 0 on success, negative errno on failure
 */
// int node_to_ap(struct gb_message *msg, uint16_t cport);

/*
 * Send a message to the AP
 *
 * @msg: The message to send
 * @cport: The cport of ap
 *
 * Returns 0 on success, negative errno on failure
 */
// int ap_to_node(struct gb_message *msg, uint16_t cport);

// int ap_register_node(uint16_t cport, node_send_fn fn, void *priv);

// int ap_derigster_node(uint16_t cport);

#endif
```

## include/error_handling.h
```c
/*
 * This file just provides helpers to handle errors
 */

#ifndef ERROR_HANDLING_H
#define ERROR_HANDLING_H

#define SUCCESS 0
#define E_NOT_FOUND 1
#define E_INVALID_CPORT_ALLOC 2
#define E_TABLE_FULL 3
#define E_EMPTY 4
#define E_NO_HEAP_MEM 5
#define E_UNINITIALIZED_CPORT 6
#define E_SEND_HEADER 7
#define E_SEND_PAYLOAD 8
#define E_NOT_RESPONSE 9
#define E_CLIENT_REQUEST 10

#endif
```

## include/greybus_connections.h
```c
/* SPDX-License-Identifier: Apache-2.0 */
/*
 * Copyright (c) 2023 Ayush Singh <ayushdevel1325@gmail.com>
 */

#ifndef _GREYBUS_CONNECTIONS_H_
#define _GREYBUS_CONNECTIONS_H_

#include <zephyr/types.h>
#include <zephyr/sys/dlist.h>
#include "greybus_interfaces.h"

#define MAX_GREYBUS_CONNECTIONS CONFIG_BEAGLEPLAY_GREYBUS_MAX_NODES

/*
 * A connection between two greybus interfaces
 *
 * @param inf_ap: Greybus interface of AP.
 * @param inf_peer: Greybus interface of the peer
 * @param ap_cport_id: Cport of AP to connect to.
 * @param peer_cport_id: Cport of Peer to connect to.
 */
struct gb_connection {
	struct gb_interface *inf_ap;
	struct gb_interface *inf_peer;
	uint16_t ap_cport_id;
	uint16_t peer_cport_id;
	sys_dnode_t node;
};

/*
 * Create a greybus connection between two interfaces
 *
 * @param Greybus AP Interface
 * @param Greybus Peer Interface
 * @param Greybus AP Interface Cport ID
 * @param Greybus Peer Interface Cport ID
 *
 * @return greybus connection allocated on heap. Null in case of errro
 */
struct gb_connection *gb_connection_create(struct gb_interface *intf1, struct gb_interface *intf2,
					   uint16_t intf1_cport_id, uint16_t intf2_cport_id);

/*
 * Destroy greybus connection
 *
 * @param interface 1
 * @param interface 2
 * @param interface 1 cport
 * @param interface 2 cport
 *
 * @return 0 on success. Negative in case of error
 */
int gb_connection_destroy(struct gb_interface *intf1, struct gb_interface *intf2,
			  uint16_t intf1_cport_id, uint16_t intf2_cport_id);

/*
 * Execute a function on all active connections
 */
void gb_connection_process_all();

/*
 * Remove all greybus connections
 *
 * Note: This does not remove the interfaces
 */
void gb_connection_destroy_all(void);

/*
 * Destroy all connections related to an interface
 *
 * @param greybus interface
 */
void gb_connection_destroy_by_interface(struct gb_interface *intf);

#endif
```

## include/greybus_interfaces.h
```c
/* SPDX-License-Identifier: Apache-2.0 */
/*
 * Copyright (c) 2023 Ayush Singh <ayushdevel1325@gmail.com>
 */

#ifndef _OPERATIONS_H_
#define _OPERATIONS_H_

#include <zephyr/sys/dlist.h>
#include <zephyr/types.h>
#include "greybus_messages.h"

struct gb_interface;

/*
 * Callback for writing to an interface
 *
 * @param controller
 * @param greybus message to send
 * @param Cport to write to
 *
 * @return 0 if successful. Negative in case of error
 */
typedef int (*gb_controller_write_callback_t)(struct gb_interface *, struct gb_message *, uint16_t);

/*
 * Callback to create new connection with a Cport in the interface
 *
 * @param controller
 * @param cport
 *
 * @return 0 if successful. Negative in case of error
 */
typedef int (*gb_controller_create_connection_t)(struct gb_interface *, uint16_t);

/*
 * Callback to destroy connection with a Cport in the interface
 *
 * @param controller
 * @param cport
 */
typedef void (*gb_controller_destroy_connection_t)(struct gb_interface *, uint16_t);

/*
 * A greybus interface. Can have multiple Cports
 *
 * @param id: Interface ID
 * @param write: a non-blocking write function. The ownership of message is
 * transferred.
 * @param ctrl_data: private controller data
 */
struct gb_interface {
	uint8_t id;
	gb_controller_write_callback_t write;
	gb_controller_create_connection_t create_connection;
	gb_controller_destroy_connection_t destroy_connection;
	void *ctrl_data;
};

/*
 * Allocate a greybus interface
 *
 * @param read callback
 * @param write callback
 * @param create connection callback
 * @param destroy connection callback
 * @param controller data
 *
 * @return allocated greybus interface. NULL in case of error
 */
struct gb_interface *gb_interface_alloc(gb_controller_write_callback_t write_cb,
					gb_controller_create_connection_t create_connection_cb,
					gb_controller_destroy_connection_t destroy_connection_cb,
					void *ctrl_data);

/*
 * Deallocate a greybus interface
 *
 * @param greybus interface
 */
void gb_interface_dealloc(struct gb_interface *intf);

/*
 * Get interface associated with interface id.
 *
 * @param interface id
 *
 * @param greybus interface
 */
struct gb_interface *gb_interface_find_by_id(uint8_t intf_id);

#endif
```

## include/greybus_messages.h
```c
/* SPDX-License-Identifier: Apache-2.0 */
/*
 * Copyright (c) 2023 Ayush Singh <ayushdevel1325@gmail.com>
 */

#ifndef _GREYBUS_MESSAGES_H_
#define _GREYBUS_MESSAGES_H_

#include <zephyr/types.h>
#include <zephyr/sys/byteorder.h>
#include "greybus_protocols.h"
#include <string.h>

/*
 * Struct to represent greybus message. This is a variable sized type.
 *
 * @param header: greybus msg header.
 * @param payload_size: size of payload in bytes
 * @param payload: heap allocated payload.
 */
struct gb_message {
	struct gb_operation_msg_hdr header;
	uint8_t payload[];
};

/*
 * Return the paylaod length of a greybus message from message header.
 *
 * @param hdr: greybus header
 *
 * @return payload length
 */
static inline size_t gb_hdr_payload_len(const struct gb_operation_msg_hdr *hdr)
{
	return sys_le16_to_cpu(hdr->size) - sizeof(struct gb_operation_msg_hdr);
}

/*
 * Return the paylaod length of a greybus message.
 *
 * @param msg: Greybus message
 *
 * @return payload length
 */
static inline size_t gb_message_payload_len(const struct gb_message *msg)
{
	return gb_hdr_payload_len(&msg->header);
}

/*
 * Check if the greybus message header is a response.
 *
 * @param hdr: greybus header
 *
 * @return true if message is response, else false.
 */
static inline bool gb_hdr_is_response(const struct gb_operation_msg_hdr *hdr)
{
	return hdr->type & GB_OP_RESPONSE;
}

/*
 * Check if the greybus message header is a successful.
 *
 * @param hdr: greybus header
 *
 * @return true if message is successful, else false.
 */
static inline bool gb_hdr_is_success(const struct gb_operation_msg_hdr *hdr)
{
	return hdr->result == 0x00;
}

/*
 * Check if the greybus message is a response.
 *
 * @param msg: greybus message
 *
 * @return true if message is response, else false.
 */
static inline bool gb_message_is_response(const struct gb_message *msg)
{
	return gb_hdr_is_response(&msg->header);
}

/*
 * Check if the greybus message is a successful.
 *
 * @param msg: greybus message
 *
 * @return true if message is successful, else false.
 */
static inline bool gb_message_is_success(const struct gb_message *msg)
{
	return gb_hdr_is_success(&msg->header);
}

/*
 * Allocate Greybus message
 *
 * @param Payload len
 * @param Response Type
 * @param Operation ID of Request
 * @param Status
 *
 * @return greybus message allocated on heap. Null in case of error
 */
struct gb_message *gb_message_alloc(size_t payload_len, uint8_t message_type, uint16_t operation_id,
				    uint8_t status);

/*
 * Deallocate a greybus message.
 *
 * @param pointer to the message to deallcate
 */
void gb_message_dealloc(struct gb_message *msg);

/*
 * Allocate a greybus request message
 *
 * @param Payload
 * @param Payload len
 * @param Request Type
 * @param Is one shot
 *
 * @return greybus message allocated on heap. Null in case of error
 */
struct gb_message *gb_message_request_alloc(const void *payload, size_t payload_len,
					    uint8_t request_type, bool is_oneshot);

/*
 * Allocate a greybus response message
 *
 * @param Payload
 * @param Payload len
 * @param Request Type
 * @param Operation ID of Request
 * @param Status
 *
 * @return greybus message allocated on heap. Null in case of error
 */
static inline struct gb_message *gb_message_response_alloc(const void *payload, size_t payload_len,
							   uint8_t request_type,
							   uint16_t operation_id, uint8_t status)
{
	struct gb_message *msg =
		gb_message_alloc(payload_len, GB_OP_RESPONSE | request_type, operation_id, status);
	memcpy(msg->payload, payload, payload_len);
	return msg;
}

static inline uint8_t gb_message_type(const struct gb_message *msg)
{
	return msg->header.type;
}

#endif
```

## include/greybus_protocol.h
```c
/* SPDX-License-Identifier: (GPL-2.0 OR BSD-3-Clause) */
/*
 * Copyright(c) 2014 - 2015 Google Inc. All rights reserved.
 * Copyright(c) 2014 - 2015 Linaro Ltd. All rights reserved.
 *
 * Modifications Copyright (c) 2023 Ayush Singh <ayushdevel1325@gmail.com>
 */

#ifndef GREYBUS_PROTOCOL_H
#define GREYBUS_PROTOCOL_H

#include <stdbool.h>
#include <stdint.h>
#include <zephyr/types.h>

/* Version of the Greybus SVC protocol we support */
#define GB_SVC_VERSION_MAJOR 0x00
#define GB_SVC_VERSION_MINOR 0x01

#define OP_RESPONSE 0x80

/* Greybus SVC request types */
#define GB_SVC_TYPE_PROTOCOL_VERSION_REQUEST      0x01
#define GB_SVC_TYPE_PROTOCOL_VERSION_RESPONSE     (OP_RESPONSE | GB_SVC_TYPE_PROTOCOL_VERSION_REQUEST)
#define GB_SVC_TYPE_HELLO_REQUEST                 0x02
#define GB_SVC_TYPE_HELLO_RESPONSE                (OP_RESPONSE | GB_SVC_TYPE_HELLO_REQUEST)
#define GB_SVC_TYPE_INTF_DEVICE_ID_REQUEST        0x03
#define GB_SVC_TYPE_INTF_DEVICE_ID_RESPONSE       (OP_RESPONSE | GB_SVC_TYPE_INTF_DEVICE_ID_REQUEST)
#define GB_SVC_TYPE_CONN_CREATE_REQUEST           0x07
#define GB_SVC_TYPE_CONN_CREATE_RESPONSE          (OP_RESPONSE | GB_SVC_TYPE_CONN_CREATE_REQUEST)
#define GB_SVC_TYPE_CONN_DESTROY_REQUEST          0x08
#define GB_SVC_TYPE_CONN_DESTROY_RESPONSE         (OP_RESPONSE | GB_SVC_TYPE_CONN_DESTROY_REQUEST)
#define GB_SVC_TYPE_DME_PEER_GET_REQUEST          0x09
#define GB_SVC_TYPE_DME_PEER_GET_RESPONSE         (OP_RESPONSE | GB_SVC_TYPE_DME_PEER_GET_REQUEST)
#define GB_SVC_TYPE_DME_PEER_SET_REQUEST          0x0a
#define GB_SVC_TYPE_DME_PEER_SET_RESPONSE         (OP_RESPONSE | GB_SVC_TYPE_DME_PEER_SET_REQUEST)
#define GB_SVC_TYPE_ROUTE_CREATE_REQUEST          0x0b
#define GB_SVC_TYPE_ROUTE_CREATE_RESPONSE         (OP_RESPONSE | GB_SVC_TYPE_ROUTE_CREATE_REQUEST)
#define GB_SVC_TYPE_ROUTE_DESTROY_REQUEST         0x0c
#define GB_SVC_TYPE_ROUTE_DESTROY_RESPONSE        (OP_RESPONSE | GB_SVC_TYPE_ROUTE_DESTROY_REQUEST)
#define GB_SVC_TYPE_INTF_SET_PWRM_REQUEST         0x10
#define GB_SVC_TYPE_INTF_SET_PWRM_RESPONSE        (OP_RESPONSE | GB_SVC_TYPE_INTF_SET_PWRM_REQUEST)
#define GB_SVC_TYPE_PING_REQUEST                  0x13
#define GB_SVC_TYPE_PING_RESPONSE                 (OP_RESPONSE | GB_SVC_TYPE_PING_REQUEST)
#define GB_SVC_TYPE_PWRMON_RAIL_COUNT_GET_REQUEST 0x14
#define GB_SVC_TYPE_PWRMON_RAIL_COUNT_GET_RESPONSE                                                 \
	(OP_RESPONSE | GB_SVC_TYPE_PWRMON_RAIL_COUNT_GET_REQUEST)
#define GB_SVC_TYPE_MODULE_INSERTED_REQUEST    0x1f
#define GB_SVC_TYPE_MODULE_INSERTED_RESPONSE   (OP_RESPONSE | GB_SVC_TYPE_MODULE_INSERTED_REQUEST)
#define GB_SVC_TYPE_MODULE_REMOVED_REQUEST     0x20
#define GB_SVC_TYPE_MODULE_REMOVED_RESPONSE    (OP_RESPONSE | GB_SVC_TYPE_MODULE_REMOVED_REQUEST)
#define GB_SVC_TYPE_INTF_VSYS_ENABLE_REQUEST   0x21
#define GB_SVC_TYPE_INTF_VSYS_ENABLE_RESPONSE  (OP_RESPONSE | GB_SVC_TYPE_INTF_VSYS_ENABLE_REQUEST)
#define GB_SVC_TYPE_INTF_VSYS_DISABLE_REQUEST  0x22
#define GB_SVC_TYPE_INTF_VSYS_DISABLE_RESPONSE (OP_RESPONSE | GB_SVC_TYPE_INTF_VSYS_DISABLE_REQUEST)
#define GB_SVC_TYPE_INTF_REFCLK_ENABLE_REQUEST 0x23
#define GB_SVC_TYPE_INTF_REFCLK_ENABLE_RESPONSE                                                    \
	(OP_RESPONSE | GB_SVC_TYPE_INTF_REFCLK_ENABLE_REQUEST)
#define GB_SVC_TYPE_INTF_REFCLK_DISABLE_REQUEST 0x24
#define GB_SVC_TYPE_INTF_REFCLK_DISABLE_RESPONSE                                                   \
	(OP_RESPONSE | GB_SVC_TYPE_INTF_VSYS_DISABLE_REQUEST)
#define GB_SVC_TYPE_INTF_UNIPRO_ENABLE_REQUEST 0x25
#define GB_SVC_TYPE_INTF_UNIPRO_ENABLE_RESPONSE                                                    \
	(OP_RESPONSE | GB_SVC_TYPE_INTF_UNIPRO_ENABLE_REQUEST)
#define GB_SVC_TYPE_INTF_UNIPRO_DISABLE_REQUEST 0x26
#define GB_SVC_TYPE_INTF_UNIPRO_DISABLE_RESPONSE                                                   \
	(OP_RESPONSE | GB_SVC_TYPE_INTF_UNIPRO_DISABLE_REQUEST)
#define GB_SVC_TYPE_INTF_ACTIVATE_REQUEST  0x27
#define GB_SVC_TYPE_INTF_ACTIVATE_RESPONSE (OP_RESPONSE | GB_SVC_TYPE_INTF_ACTIVATE_REQUEST)
#define GB_SVC_TYPE_INTF_RESUME_REQUEST    0x28
#define GB_SVC_TYPE_INTF_RESUME_RESPONSE   (OP_RESPONSE | GB_SVC_TYPE_INTF_RESUME_REQUEST)

#define GB_SVC_UNIPRO_HIBERNATE_MODE 0x11

#define GB_SVC_SETPWRM_PWR_OK    0x00
#define GB_SVC_SETPWRM_PWR_LOCAL 0x01

#define GB_SVC_INTF_VSYS_OK 0x00

#define GB_SVC_INTF_REFCLK_OK 0x00

#define GB_SVC_INTF_UNIPRO_OK 0x00

#define GB_SVC_INTF_TYPE_GREYBUS 0x03

/* Greybus SVC protocol status values */
#define GB_SVC_OP_SUCCESS               0x00
#define GB_SVC_OP_UNKNOWN_ERROR         0x01
#define GB_SVC_INTF_NOT_DETECTED        0x02
#define GB_SVC_INTF_NO_UPRO_LINK        0x03
#define GB_SVC_INTF_UPRO_NOT_DOWN       0x04
#define GB_SVC_INTF_UPRO_NOT_HIBERNATED 0x05
#define GB_SVC_INTF_NO_V_SYS            0x06
#define GB_SVC_INTF_V_CHG               0x07
#define GB_SVC_INTF_WAKE_BUSY           0x08
#define GB_SVC_INTF_NO_REFCLK           0x09
#define GB_SVC_INTF_RELEASING           0x0a
#define GB_SVC_INTF_NO_ORDER            0x0b
#define GB_SVC_INTF_MBOX_SET            0x0c
#define GB_SVC_INTF_BAD_MBOX            0x0d
#define GB_SVC_INTF_OP_TIMEOUT          0x0e
#define GB_SVC_PWRMON_OP_NOT_PRESENT    0x0f

/*
 * All operation messages (both requests and responses) begin with
 * a header that encodes the size of the message (header included).
 * This header also contains a unique identifier, that associates a
 * response message with its operation.  The header contains an
 * operation type field, whose interpretation is dependent on what
 * type of protocol is used over the connection.  The high bit
 * (0x80) of the operation type field is used to indicate whether
 * the message is a request (clear) or a response (set).
 *
 * Response messages include an additional result byte, which
 * communicates the result of the corresponding request.  A zero
 * result value means the operation completed successfully.  Any
 * other value indicates an error; in this case, the payload of the
 * response message (if any) is ignored.  The result byte must be
 * zero in the header for a request message.
 *
 * The wire format for all numeric fields in the header is little
 * endian.  Any operation-specific data begins immediately after the
 * header.
 */
struct gb_operation_msg_hdr {
	uint16_t size;  /* Size in bytes of header + payload */
	uint16_t id;    /* Operation unique id */
	uint8_t type;   /* E.g GB_I2C_TYPE_TRANSFER */
	uint8_t status; /* Result of request (in responses only) */
	uint8_t pad[2]; /* must be zero (ignore when read) */
} __packed;

enum gb_operation_type {
	GB_TYPE_RESPONSE_FLAG = 0x80,
};

enum gb_operation_result {
	GB_OP_SUCCESS = 0x00,
	GB_OP_INTERRUPTED = 0x01,
	GB_OP_TIMEOUT = 0x02,
	GB_OP_NO_MEMORY = 0x03,
	GB_OP_PROTOCOL_BAD = 0x04,
	GB_OP_OVERFLOW = 0x05,
	GB_OP_INVALID = 0x06,
	GB_OP_RETRY = 0x07,
	GB_OP_NONEXISTENT = 0x08,
	GB_OP_INVALID_STATE = 0x09,
	GB_OP_UNKNOWN_ERROR = 0xfe,
	GB_OP_INTERNAL = 0xff,
};

#define GB_COMMON_TYPE_CPORT_SHUTDOWN_REQUEST 0x00

/* Greybus Control Protocol Operations */
#define GB_CONTROL_TYPE_CPORT_SHUTDOWN_RESPONSE                                                    \
	(OP_RESPONSE | GB_CONTROL_TYPE_CPORT_SHUTDOWN_REQUEST)
#define GB_CONTROL_TYPE_VERSION_REQUEST            0x01
#define GB_CONTROL_TYPE_VERSION_RESPONSE           (OP_RESPONSE | GB_CONTROL_TYPE_VERSION_REQUEST)
#define GB_CONTROL_TYPE_GET_MANIFEST_SIZE_REQUEST  0x03
#define GB_CONTROL_TYPE_GET_MANIFEST_SIZE_RESPONSE (OP_RESPONSE | GB_CONTROL_TYPE_VERSION_REQUEST)
#define GB_CONTROL_TYPE_GET_MANIFEST_REQUEST       0x04
#define GB_CONTROL_TYPE_GET_MANIFEST_RESPONSE      (OP_RESPONSE | GB_CONTROL_TYPE_GET_MANIFEST_REQUEST)
#define GB_CONTROL_TYPE_CONNECTED_REQUEST          0x05
#define GB_CONTROL_TYPE_CONNECTED_RESPONSE         (OP_RESPONSE | GB_CONTROL_TYPE_CONNECTED_REQUEST)
#define GB_CONTROL_TYPE_DISCONNECTED_REQUEST       0x06
#define GB_CONTROL_TYPE_DISCONNECTED_RESPONSE      (OP_RESPONSE | GB_CONTROL_TYPE_DISCONNECTED_REQUEST)
#define GB_CONTROL_TYPE_TIMESYNC_ENABLE_REQUEST    0x07
#define GB_CONTROL_TYPE_TIMESYNC_ENABLE_RESPONSE                                                   \
	(OP_RESPONSE | GB_CONTROL_TYPE_TIMESYNC_ENABLE_REQUEST)
#define GB_CONTROL_TYPE_TIMESYNC_DISABLE_REQUEST 0x08
#define GB_CONTROL_TYPE_TIMESYNC_DISABLE_RESPONSE                                                  \
	(OP_RESPONSE | GB_CONTROL_TYPE_TIMESYNC_DISABLE_REQUEST)
#define GB_CONTROL_TYPE_TIMESYNC_AUTHORITATIVE_REQUEST 0x09
#define GB_CONTROL_TYPE_TIMESYNC_AUTHORITATIVE_RESPONSE                                            \
	(OP_RESPONSE | GB_CONTROL_TYPE_TIMESYNC_AUTHORITATIVE_REQUEST)
/*	Unused					0x0a */
#define GB_CONTROL_TYPE_BUNDLE_VERSION_REQUEST 0x0b
#define GB_CONTROL_TYPE_BUNDLE_VERSION_RESPONSE                                                    \
	(OP_RESPONSE | GB_CONTROL_TYPE_BUNDLE_VERSION_REQUEST)
#define GB_CONTROL_TYPE_DISCONNECTING_REQUEST           0x0c
#define GB_CONTROL_TYPE_DISCONNECTING_RESPONSE          (OP_RESPONSE | GB_CONTROL_TYPE_DISCONNECTING_REQUEST)
#define GB_CONTROL_TYPE_TIMESYNC_GET_LAST_EVENT_REQUEST 0x0d
#define GB_CONTROL_TYPE_TIMESYNC_GET_LAST_EVENT_RESPONSE                                           \
	(OP_RESPONSE | GB_CONTROL_TYPE_TIMESYNC_GET_LAST_EVENT_REQUEST)
#define GB_CONTROL_TYPE_MODE_SWITCH_REQUEST    0x0e
#define GB_CONTROL_TYPE_MODE_SWITCH_RESPONSE   (OP_RESPONSE | GB_CONTROL_TYPE_MODE_SWITCH_REQUEST)
#define GB_CONTROL_TYPE_BUNDLE_SUSPEND_REQUEST 0x0f
#define GB_CONTROL_TYPE_BUNDLE_SUSPEND_RESPONSE                                                    \
	(OP_RESPONSE | GB_CONTROL_TYPE_BUNDLE_SUSPEND_REQUEST)
#define GB_CONTROL_TYPE_BUNDLE_RESUME_REQUEST     0x10
#define GB_CONTROL_TYPE_BUNDLE_RESUME_RESPONSE    (OP_RESPONSE | GB_CONTROL_TYPE_BUNDLE_RESUME_REQUEST)
#define GB_CONTROL_TYPE_BUNDLE_DEACTIVATE_REQUEST 0x11
#define GB_CONTROL_TYPE_BUNDLE_DEACTIVATE_RESPONSE                                                 \
	(OP_RESPONSE | GB_CONTROL_TYPE_BUNDLE_DEACTIVATE_REQUEST)
#define GB_CONTROL_TYPE_BUNDLE_ACTIVATE_REQUEST 0x12
#define GB_CONTROL_TYPE_BUNDLE_ACTIVATE_RESPONSE                                                   \
	(OP_RESPONSE | GB_CONTROL_TYPE_BUNDLE_ACTIVATE_REQUEST)
#define GB_CONTROL_TYPE_INTF_SUSPEND_PREPARE_REQUEST 0x13
#define GB_CONTROL_TYPE_INTF_SUSPEND_PREPARE_RESPONSE                                              \
	(OP_RESPONSE | GB_CONTROL_TYPE_INTF_SUSPEND_PREPARE_REQUEST)
#define GB_CONTROL_TYPE_INTF_DEACTIVATE_PREPARE_REQUEST 0x14
#define GB_CONTROL_TYPE_INTF_DEACTIVATE_PREPARE_RESPONSE                                           \
	(OP_RESPONSE | GB_CONTROL_TYPE_INTF_DEACTIVATE_PREPARE_REQUEST)
#define GB_CONTROL_TYPE_INTF_HIBERNATE_ABORT_REQUEST 0x15
#define GB_CONTROL_TYPE_INTF_HIBERNATE_ABORT_RESPONSE                                              \
	(OP_RESPONSE | GB_CONTROL_TYPE_INTF_HIBERNATE_ABORT_REQUEST)

/* Greybus Log Protocol Operations */
#define GB_LOG_TYPE_SEND_LOG_REQUEST  0x02
#define GB_LOG_TYPE_SEND_LOG_RESPONSE (OP_RESPONSE | GB_LOG_TYPE_SEND_LOG_REQUEST)

#endif
```

## include/hdlc.h
```c
/* SPDX-License-Identifier: Apache-2.0 */
/*
 * Copyright (c) 2023 Ayush Singh <ayushdevel1325@gmail.com>
 */

#ifndef _HDLC_H_
#define _HDLC_H_

#include "greybus_messages.h"
#include <stdint.h>
#include <zephyr/device.h>

#define HDLC_MAX_BLOCK_SIZE CONFIG_BEAGLEPLAY_HDLC_MAX_BLOCK_SIZE

#define ADDRESS_GREYBUS 0x01
#define ADDRESS_DBG     0x02
#define ADDRESS_CONTROL 0x03
#define ADDRESS_MCUMGR  0x04

/*
 * Calback to process a received HDLC frame
 *
 * @param payload
 * @param payload len
 * @param HDLC address
 *
 * @return Negative in case of error
 */
typedef int (*hdlc_process_frame_callback)(const void *, size_t, uint8_t);

/*
 * Callback to send HDLC data
 *
 * @param buffer
 * @param buffer length
 *
 * @return Number of bytes sent, negative in case of error
 */
typedef int (*hdlc_send_frame_callback)(const uint8_t *, size_t);

/*
 * Initialize internal HDLC stuff
 *
 * @return 0 if successful. Negative in case of error.
 */
int hdlc_init(hdlc_process_frame_callback process_cb, hdlc_send_frame_callback send_cb);

/*
 * Submit an HDLC Block synchronously
 *
 * @param buffer
 * @param buffer_length
 * @param address
 * @param control
 *
 * @return block size (>= 0) if successful. Negative in case of error
 */
int hdlc_block_send_sync(const uint8_t *buffer, size_t buffer_len, uint8_t address,
			 uint8_t control);

/*
 * Get a buffer to write HDLC message received for processing. Make HDLC transport agnostic.
 *
 * @param the pointer to underlying buffer which can be used to write.
 *
 * @return number of bytes that can be written
 */
uint32_t hdlc_rx_start(uint8_t **buffer);

/*
 * Finish writing to rx buffer. Also queues rx buffer for processing
 *
 * @param number of bytes written
 *
 * @return 0 if successful. Negative in case of error.
 */
int hdlc_rx_finish(uint32_t written);

/*
 * Send a greybus message over HDLC
 *
 * @param Greybus message
 */
static inline int gb_message_hdlc_send(struct gb_message *msg, uint16_t cport)
{
	char buffer[HDLC_MAX_BLOCK_SIZE];

	memcpy(buffer, &sys_cpu_to_le16(cport), sizeof(cport));
	memcpy(&buffer[sizeof(cport)], &msg->header, sizeof(struct gb_operation_msg_hdr));
	memcpy(&buffer[sizeof(struct gb_operation_msg_hdr) + sizeof(cport)], msg->payload,
	       gb_message_payload_len(msg));

	hdlc_block_send_sync(buffer, msg->header.size + sizeof(cport), ADDRESS_GREYBUS, 0x03);

	return 0;
}

#endif
```

## include/local_node.h
```c
#ifndef _LOCAL_NODE_H_
#define _LOCAL_NODE_H_

#define LOCAL_NODE_ID 2

struct gb_interface *local_node_interface(void);

#endif
```

## include/manifest.h
```c
#ifndef MANIFEST_H
#define MANIFEST_H

#include "greybus-manifest.h"
#include <stdint.h>
#include <zephyr/sys/slist.h>

struct gb_cport {
  sys_snode_t node;
  int id;
  int bundle;
  int protocol;
};

sys_slist_t gb_manifest_get_cports(void *, size_t);

void gb_cports_free(sys_slist_t);

#endif
```

## include/mcumgr.h
```c
/* SPDX-License-Identifier: Apache-2.0 */
/*
 * Copyright (c) 2023 Ayush Singh <ayushdevel1325@gmail.com>
 */

#ifndef _MCUMGR_H_
#define _MCUMGR_H_

#include <stddef.h>
#include <zephyr/toolchain.h>

#ifdef CONFIG_BEAGLEPLAY_GREYBUS_MCUMGR
int mcumgr_init(void);
#else
static int mcumgr_init(void)
{
	return 0;
}
#endif

#ifdef CONFIG_BEAGLEPLAY_GREYBUS_MCUMGR
int mcumgr_process_frame(const void *buffer, size_t buffer_len);
#else
static int mcumgr_process_frame(const void *buffer, size_t buffer_len)
{
	ARG_UNUSED(buffer);
	ARG_UNUSED(buffer_len);
	return 0;
}
#endif

#endif
```
